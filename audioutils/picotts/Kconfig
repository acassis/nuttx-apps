## audioutils/picotts/Kconfig
```kconfig
#
# For a description of the syntax of this configuration file,
# see the file kconfig-language.txt in the NuttX tools repository.
#

menuconfig AUDIOUTILS_PICOTTS
	bool "Pico TTS Text-to-Speech"
	default n
	---help---
		Pico TTS is a text-to-speech engine originally from Android/SVOX.
		This port provides TTS for NuttX with support for English (US/UK),
		German, French, Italian, and Spanish.

		Resources: ~175KB code, ~800KB language data, ~1.1MB RAM

if AUDIOUTILS_PICOTTS

choice
	prompt "Voice language"
	default PICOTTS_LANGUAGE_EN_US

config PICOTTS_LANGUAGE_EN_US
	bool "English (US)"

config PICOTTS_LANGUAGE_EN_GB
	bool "English (UK)"

endchoice

config PICOTTS_TA_RESOURCE
	string "TA resource path"
	default "/romfs/en-US_ta.bin" if PICOTTS_LANGUAGE_EN_US
	default "/romfs/en-GB_ta.bin" if PICOTTS_LANGUAGE_EN_GB

config PICOTTS_SG_RESOURCE
	string "SG resource path"
	default "/romfs/en-US_lh0_sg.bin" if PICOTTS_LANGUAGE_EN_US
	default "/romfs/en-GB_kh0_sg.bin" if PICOTTS_LANGUAGE_EN_GB

config PICOTTS_AUDIO_DEVICE
	string "Audio output device"
	default "/dev/audio0"

config PICOTTS_INPUT_QUEUE_SIZE
	int "TTS input queue size (bytes)"
	default 256

config PICOTTS_PRIORITY
	int "TTS thread priority"
	default 120

config PICOTTS_STACK_SIZE
	int "TTS thread stack size"
	default 8192

config PICOTTS_NSH_CMD
	bool "NSH 'picotts' command"
	default y
	---help---
		Adds a 'picotts' command to NuttShell for speaking text
		from the command line.

endif # AUDIOUTILS_PICOTTS
```

## examples/cfltk_button_demo/Kconfig
```kconfig
config EXAMPLES_CFLTK_BUTTON_DEMO
	tristate "cFLTK button click demo"
	default n
	depends on GRAPHICS_CFLTK
	depends on GRAPHICS_CFLTK_BACKEND_NX
	---help---
		A window with a clickable Fl_Button that increments a counter
		label on each click -- exercises the NuttX/Microwindows-mwin
		backend's mouse event translation (fl_nx_event.c's WM_LBUTTONDOWN/
		WM_LBUTTONUP handling) and cfltk's own click-dispatch/redraw path
		end to end, with real input (not just passive rendering). Matches
		the project's "button_demo" example.

		Prints "clicks=N" to the console on every click, so the click
		pipeline can be verified from the boot log alone even without a
		display attached.

if EXAMPLES_CFLTK_BUTTON_DEMO

config EXAMPLES_CFLTK_BUTTON_DEMO_PROGNAME
	string "Program name"
	default "cfltk_button_demo"

config EXAMPLES_CFLTK_BUTTON_DEMO_PRIORITY
	int "cfltk_button_demo task priority"
	default 100

config EXAMPLES_CFLTK_BUTTON_DEMO_STACKSIZE
	int "cfltk_button_demo stack size"
	default 32768

endif
```

## examples/cfltk_dnd_demo/Kconfig
```kconfig
config EXAMPLES_CFLTK_DND_DEMO
	tristate "cFLTK drag-and-drop demo"
	default n
	depends on GRAPHICS_CFLTK
	depends on GRAPHICS_CFLTK_BACKEND_NX
	---help---
		A "Drag me" box and an empty Fl_Input side by side -- pressing
		on the box starts an intra-application drag (Fl_dnd()) carrying
		fixed text, dropped wherever the mouse is released. Exercises
		the NuttX/Microwindows-mwin backend's fl_backend_dnd_start()
		(fl_nx_dnd.c): SetCapture()-based mouse tracking,
		WindowFromPoint()-based hit testing, and the FL_DND_ENTER/
		FL_DND_DRAG/FL_DND_RELEASE dispatch feeding the drop into the
		Fl_Input via the same Fl_copy()/Fl_paste() path an ordinary
		clipboard paste uses. No other cfltk_* demo reaches any of
		this.

		Unlike the X11 backend's real cross-process Xdnd, this is
		necessarily intra-application only: mwin owns the whole screen
		as a single process, so there is no other application on this
		platform to drop onto or accept a drop from.

		Prints "drag started, dropped=N" to the console once the drag
		gesture completes.

if EXAMPLES_CFLTK_DND_DEMO

config EXAMPLES_CFLTK_DND_DEMO_PROGNAME
	string "Program name"
	default "cfltk_dnd_demo"

config EXAMPLES_CFLTK_DND_DEMO_PRIORITY
	int "cfltk_dnd_demo task priority"
	default 100

config EXAMPLES_CFLTK_DND_DEMO_STACKSIZE
	int "cfltk_dnd_demo stack size"
	default 32768

endif
```

## examples/cfltk_double_buffer_demo/Kconfig
```kconfig
config EXAMPLES_CFLTK_DOUBLE_BUFFER_DEMO
	tristate "cFLTK double-buffered window demo"
	default n
	depends on GRAPHICS_CFLTK
	depends on GRAPHICS_CFLTK_BACKEND_NX
	---help---
		A Fl_Double_Window (rather than cfltk_button_demo's plain
		Fl_Window) with a button that both increments a counter label
		and resizes the window on every click -- exercises the
		NuttX/Microwindows-mwin backend's offscreen-buffered draw/flush
		path (fl_nx_window.c's resize_offscreen()/BitBlt(), and
		fl_nx_offscreen.c's Fl_Offscreen create/delete/begin/end/copy),
		which no other cfltk_* demo reaches.

		Prints "clicks=N size=WxH" to the console on every click, so the
		click and resize pipeline can be verified from the boot log
		alone even without a display attached.

if EXAMPLES_CFLTK_DOUBLE_BUFFER_DEMO

config EXAMPLES_CFLTK_DOUBLE_BUFFER_DEMO_PROGNAME
	string "Program name"
	default "cfltk_double_buffer_demo"

config EXAMPLES_CFLTK_DOUBLE_BUFFER_DEMO_PRIORITY
	int "cfltk_double_buffer_demo task priority"
	default 100

config EXAMPLES_CFLTK_DOUBLE_BUFFER_DEMO_STACKSIZE
	int "cfltk_double_buffer_demo stack size"
	default 32768

endif
```

## examples/cfltk_hello/Kconfig
```kconfig
config EXAMPLES_CFLTK_HELLO
	tristate "cFLTK hello window example"
	default n
	depends on GRAPHICS_CFLTK
	depends on GRAPHICS_CFLTK_BACKEND_NX
	---help---
		A single blank cFLTK window, shown then closed on WM_CLOSE.
		The smallest possible exercise of cFLTK's NuttX/Microwindows-mwin
		backend (graphics/cfltk) -- create, show, run, done. Matches the
		project's "empty window" milestone: prove the backend end to end
		before building any real widget content on top of it.

if EXAMPLES_CFLTK_HELLO

config EXAMPLES_CFLTK_HELLO_PROGNAME
	string "Program name"
	default "cfltk_hello"

config EXAMPLES_CFLTK_HELLO_PRIORITY
	int "cfltk_hello task priority"
	default 100

config EXAMPLES_CFLTK_HELLO_STACKSIZE
	int "cfltk_hello stack size"
	default 32768

endif
```

## examples/cfltk_image_demo/Kconfig
```kconfig
config EXAMPLES_CFLTK_IMAGE_DEMO
	tristate "cFLTK image drawing demo"
	default n
	depends on GRAPHICS_CFLTK
	depends on GRAPHICS_CFLTK_BACKEND_NX
	---help---
		A window showing an Fl_RGB_Image (a generated color gradient), a
		masked Fl_Pixmap (an XPM diamond with a transparent background),
		and an Fl_Bitmap (a 1-bit checkerboard) over a solid teal
		background -- exercises the NuttX/Microwindows-mwin backend's
		raw image blit/read-back/bitmask-stipple Fl_Graphics_Driver
		calls (d_draw_image()/d_read_image()/d_draw_bitmask() in
		fl_nx_driver.c), none of which any other cfltk_* demo reaches.
		The Fl_Pixmap's transparent pixels showing the teal background
		through them (rather than solid black/garbage) is the proof
		d_read_image() actually read real screen pixels back.

if EXAMPLES_CFLTK_IMAGE_DEMO

config EXAMPLES_CFLTK_IMAGE_DEMO_PROGNAME
	string "Program name"
	default "cfltk_image_demo"

config EXAMPLES_CFLTK_IMAGE_DEMO_PRIORITY
	int "cfltk_image_demo task priority"
	default 100

config EXAMPLES_CFLTK_IMAGE_DEMO_STACKSIZE
	int "cfltk_image_demo stack size"
	default 32768

endif
```

## examples/cfltk_input_demo/Kconfig
```kconfig
config EXAMPLES_CFLTK_INPUT_DEMO
	tristate "cFLTK text input demo"
	default n
	depends on GRAPHICS_CFLTK
	depends on GRAPHICS_CFLTK_BACKEND_NX
	---help---
		A window with a focused Fl_Input text box, printing its
		contents to the console on Enter. Exercises the NuttX/
		Microwindows-mwin backend's keyboard translation
		(fl_nx_event.c's WM_CHAR/WM_KEYDOWN handling) end to end --
		matches the project's "text boxes" example.

if EXAMPLES_CFLTK_INPUT_DEMO

config EXAMPLES_CFLTK_INPUT_DEMO_PROGNAME
	string "Program name"
	default "cfltk_input_demo"

config EXAMPLES_CFLTK_INPUT_DEMO_PRIORITY
	int "cfltk_input_demo task priority"
	default 100

config EXAMPLES_CFLTK_INPUT_DEMO_STACKSIZE
	int "cfltk_input_demo stack size"
	default 32768

endif
```

## examples/cfltk_text_demo/Kconfig
```kconfig
config EXAMPLES_CFLTK_TEXT_DEMO
	tristate "cFLTK text rendering demo"
	default n
	depends on GRAPHICS_CFLTK
	depends on GRAPHICS_CFLTK_BACKEND_NX
	---help---
		A window containing a labeled Fl_Box, exercising the NuttX/
		Microwindows-mwin backend's text/font rendering
		(fl_nx_driver.c's CreateFont/TextOut/GetTextExtentPoint path)
		end to end -- the "text_demo" example the project's
		verification approach calls for, isolating text rendering from
		everything else before it's exercised inside real widgets.

if EXAMPLES_CFLTK_TEXT_DEMO

config EXAMPLES_CFLTK_TEXT_DEMO_PROGNAME
	string "Program name"
	default "cfltk_text_demo"

config EXAMPLES_CFLTK_TEXT_DEMO_PRIORITY
	int "cfltk_text_demo task priority"
	default 100

config EXAMPLES_CFLTK_TEXT_DEMO_STACKSIZE
	int "cfltk_text_demo stack size"
	default 32768

endif
```

## examples/cfltk_timer_demo/Kconfig
```kconfig
config EXAMPLES_CFLTK_TIMER_DEMO
	tristate "cFLTK Fl_add_timeout demo"
	default n
	depends on GRAPHICS_CFLTK
	depends on GRAPHICS_CFLTK_BACKEND_NX
	---help---
		A window with a counter label that increments every 0.5s via
		Fl_repeat_timeout() -- exercises the NuttX/Microwindows-mwin
		backend's fl_backend_wait() actually sleeping a bounded amount
		(SetTimer()/WM_TIMER against a hidden message-only window,
		fl_nx_event.c) rather than busy-polling or blocking forever,
		which no other cfltk_* demo reaches (they're all purely
		input-driven).

		Prints "tick=N elapsed_ms=T" (T an integer -- NuttX's default
		printf() has no %f) to the console on every tick, so the real
		wall-clock delay between ticks can be verified from the boot
		log alone: T should land close to 500, not near-zero (busy
		spin) or absent entirely (blocked forever).

if EXAMPLES_CFLTK_TIMER_DEMO

config EXAMPLES_CFLTK_TIMER_DEMO_PROGNAME
	string "Program name"
	default "cfltk_timer_demo"

config EXAMPLES_CFLTK_TIMER_DEMO_PRIORITY
	int "cfltk_timer_demo task priority"
	default 100

config EXAMPLES_CFLTK_TIMER_DEMO_STACKSIZE
	int "cfltk_timer_demo stack size"
	default 32768

endif
```

## examples/picotts/Kconfig
```kconfig
config EXAMPLES_PICOTTS
	bool "PicoTTS example"
	default n
	depends on AUDIOUTILS_PICOTTS
	---help---
		Enable the PicoTTS text-to-speech example application.
		Usage: picotts "text to speak"
```

## graphics/cfltk/Kconfig
```kconfig
#
# For a description of the syntax of this configuration file,
# see the file kconfig-language.txt in the NuttX tools repository.
#

menuconfig GRAPHICS_CFLTK
	bool "cFLTK GUI toolkit"
	default n
	---help---
		Enable cFLTK, a from-scratch C99 reimplementation of the FLTK
		1.3 GUI toolkit and the GUI layer used by ClauCoDillo. This
		option builds cFLTK's platform-independent core only (widgets,
		valuators, menus, text, drawing, dialogs, and the image codecs
		enabled below). A windowing backend must be selected
		separately below.

if GRAPHICS_CFLTK

config GRAPHICS_CFLTK_BACKEND_NX
	bool "NuttX/Microwindows-mwin backend"
	default n
	depends on GRAPHICS_MICROWINDOWS
	depends on MICROWINDOWS_MWIN
	---help---
		Implements cFLTK's platform seam (src/backend/nx/) against
		Microwindows' mwin layer (Win32-compatible window management:
		CreateWindowEx/ShowWindow/GetMessage/DispatchMessage), not the
		raw Microwindows engine and not the Nano-X client/server (Gr*)
		protocol -- see src/backend/nx/fl_nx_internal.h for why.

		Window lifecycle, solid-color/line/rect/arc/polygon drawing,
		clipping, text/font rendering, keyboard and mouse input,
		offscreen surfaces/double buffering, raw image blit/read-back/
		bitmask stipple, Fl_add_fd()/timers, and drag-and-drop are all
		implemented -- see docs/analysis.md in the ClauCoDillo_NuttX
		project for verification status of each. Not yet implemented:
		resize hints and real screen DPI (fl_nx_window.c stubs).

config GRAPHICS_CFLTK_PNG
	bool "PNG image support (Fl_PNG_Image)"
	default n
	---help---
		Requires a libpng providing <png.h> and a linkable libpng
		available to the NuttX toolchain. There is currently no
		NuttX apps package providing this, so enabling it requires
		supplying libpng yourself.

config GRAPHICS_CFLTK_JPEG
	bool "JPEG image support (Fl_JPEG_Image)"
	default n
	depends on LIBJPEG
	---help---
		Requires apps/graphics/libjpeg.

endif # GRAPHICS_CFLTK
```

## graphics/claucodillo/Kconfig
```kconfig
#
# For a description of the syntax of this configuration file,
# see the file kconfig-language.txt in the NuttX tools repository.
#

menuconfig GRAPHICS_CLAUCODILLO
	bool "ClauCoDillo web browser"
	default n
	depends on GRAPHICS_CFLTK
	---help---
		Enable ClauCoDillo, a from-scratch C++->C99 port of the Dillo
		web browser targeting cFLTK for its GUI -- cFLTK is a hard
		dependency (dw-fltk, ClauCoDillo's own platform glue, includes
		cfltk/*.h directly), not optional. This option builds dlib
		(its own small utility library), lout (geometry/object-model
		utilities), and dw (the layout/rendering engine: widget/layout
		base classes, concrete widget types, and cfltk-specific
		platform glue) -- not yet the browser itself (src/). See
		docs/analysis.md in the ClauCoDillo_NuttX project for current
		status. ClauCoDillo's dpi-plugin subsystem (bookmarks, cookies,
		HTTPS-via-dpi, FTP, downloads) depends on a fork/exec daemon
		architecture NuttX's task model doesn't support as-is and is
		deliberately out of scope until that's redesigned -- this port
		targets local/file rendering first.

if GRAPHICS_CLAUCODILLO

config GRAPHICS_CLAUCODILLO_PROGNAME
	string "Program name"
	default "dillo"
	---help---
		This is the name of the program that will be used when the NSH ELF
		program is installed.

config GRAPHICS_CLAUCODILLO_PRIORITY
	int "ClauCoDillo task priority"
	default 100

config GRAPHICS_CLAUCODILLO_STACKSIZE
	int "ClauCoDillo stack size"
	default DEFAULT_TASK_STACKSIZE

endif # GRAPHICS_CLAUCODILLO
```

## graphics/libpng/Kconfig
```kconfig
#
# For a description of the syntax of this configuration file,
# see the file kconfig-language.txt in the NuttX tools repository.
#

config LIBPNG
	bool "libpng"
	default n
	depends on LIB_ZLIB
	---help---
		Enable libpng, the reference C implementation of the PNG
		(Portable Network Graphics) image format. Requires zlib
		(apps/system/zlib), since PNG's compression is DEFLATE-based.

		This package builds the read/decode side only (png.c,
		pngerror.c, pngget.c, pngmem.c, pngpread.c, pngread.c,
		pngrio.c, pngrtran.c, pngrutil.c, pngset.c, pngtrans.c) --
		the write-side files (pngwio.c, pngwrite.c, pngwtran.c,
		pngwutil.c) are not built, since no current NuttX apps
		package needs to *encode* PNGs. libpng is provided from
		https://github.com/pnggroup/libpng

config LIBPNG_VER
	string "libpng version"
	default "1.6.58"
	depends on LIBPNG
```

## graphics/libwebp/Kconfig
```kconfig
#
# For a description of the syntax of this configuration file,
# see the file kconfig-language.txt in the NuttX tools repository.
#

config LIBWEBP
	bool "libwebp"
	default n
	---help---
		Enable libwebp, the reference implementation of the WebP image
		format (https://github.com/webmproject/libwebp).

		Only the decode-only subset is built here (the same file set
		upstream's own "libwebpdecoder" target uses: src/dec, the
		non-SIMD portion of src/dsp, and the non-encode portion of
		src/utils) -- ClauCoDillo only decodes WebP images, it never
		encodes/muxes/demuxes them, so src/enc and src/mux are not
		built at all. SIMD-accelerated variants (SSE2/SSE4.1/AVX2/
		NEON/MSA/MIPS) are also excluded in favor of the portable C
		fallback paths, matching this port's other vendored libraries
		(no build-system CPU-feature detection is done here).

config LIBWEBP_VER
	string "libwebp version"
	default "1.6.0"
	depends on LIBWEBP
```
